## components/display/Kconfig.projbuild
```kconfig
menu "Display Configuration"

    config DISPLAY_SDA_GPIO
        int "I2C SDA GPIO Number"
        range 0 SOC_GPIO_PIN_COUNT
        default 8
        help
            Número do pino GPIO para a linha de dados SDA do barramento I2C.

    config DISPLAY_SCL_GPIO
        int "I2C SCL GPIO Number"
        range 0 SOC_GPIO_PIN_COUNT
        default 9
        help
            Número do pino GPIO para a linha de clock SCL do barramento I2C.

    config DISPLAY_RESET_GPIO
        int "Display Reset GPIO Number"
        range -1 SOC_GPIO_PIN_COUNT
        default -1
        help
            Número do pino GPIO conectado ao pino de Reset do display OLED.
            Insira -1 caso seu display não utilize um pino de reset dedicado.

endmenu
```

## components/sensors/Kconfig.projbuild
```kconfig
menu "Sensors Configuration"

    choice SENSORS_LDR_ADC_UNIT
        prompt "LDR ADC Unit"
        default SENSORS_LDR_ADC_UNIT_1
        help
            Unidade de ADC (ADC_UNIT_1 ou ADC_UNIT_2) que será usada pelo LDR.

        config SENSORS_LDR_ADC_UNIT_1
            bool "ADC Unit 1"
        config SENSORS_LDR_ADC_UNIT_2
            bool "ADC Unit 2"
    endchoice

    config SENSORS_LDR_ADC_CHANNEL
        int "LDR ADC Channel (0-9)"
        range 0 SOC_ADC_MAX_CHANNEL_NUM
        default 0
        help
            Selecione o canal do ADC (0 a 9) correspondente ao pino conectado ao LDR.
            No ESP32-S3, por exemplo, o Canal 0 do ADC1 equivale ao GPIO1.

    config DHT11_PIN
        int "DHT11 GPIO Number"
        range 0 SOC_GPIO_IN_RANGE_MAX
        default 15
        help
            Número do GPIO (IOxx) para o sensor DHT11.

endmenu
```

## main/Kconfig.projbuild
```kconfig
menu "GPIOs Configuration"

    config UP_BUTTON_PIN
        int "UP GPIO Number"
        range 0 SOC_GPIO_PIN_COUNT
        default 7
        help
            Número do GPIO (IOxx) para o botão UP.

    config LEFT_BUTTON_PIN
        int "LEFT GPIO Number"
        range 0 SOC_GPIO_PIN_COUNT
        default 6
        help
            Número do GPIO (IOxx) para o botão LEFT.
        
    config RIGHT_BUTTON_PIN
        int "RIGHT GPIO Number"
        range 0 SOC_GPIO_PIN_COUNT
        default 5
        help
            Número do GPIO (IOxx) para o botão RIGHT.

    config DOWN_BUTTON_PIN
        int "DOWN GPIO Number"
        range 0 SOC_GPIO_PIN_COUNT
        default 4
        help
            Número do GPIO (IOxx) para o botão DOWN.

    config SAVE_LOG_BUTTON_PIN
        int "SAVE LOG GPIO Number"
        range 0 SOC_GPIO_PIN_COUNT
        default 3
        help
            Número do GPIO (IOxx) para o botão de salvar log.

    config BUZZER_BUTTON_PIN
        int "Enable/Disable BUZZER GPIO Number"
        range 0 SOC_GPIO_PIN_COUNT
        default 2
        help
            Número do GPIO (IOxx) para o botão de habilitar/desabilitar o buzzer.
    
    config FAN_PIN
        int "FAN GPIO Number"
        range 0 SOC_GPIO_PIN_COUNT
        default 14
        help
            Número do GPIO (IOxx) para o controle do ventilador.

    config DEFAULT_TEMP_SETPOINT
        int "Default Setpoint Temperature (°C)"
        range 0 100
        default 25
        help
            Temperatura de referência padrão (em °C) para o controle do ventilador.

    config DEFAULT_REGISTER_STATUS
        bool "Default Register Status"
        default y
        help
            Define se o registro de status será habilitado por padrão.

    config DEFAULT_TEMP_CONTROL_STATUS
        bool "Default Temperature Control Status"
        default y
        help
            Define se o controle de temperatura será habilitado por padrão.
endmenu
```

## sdkconfig.defaults
```kconfig
CONFIG_PARTITION_TABLE_CUSTOM=y
CONFIG_PARTITION_TABLE_CUSTOM_FILENAME="partitions_2MB.csv"
CONFIG_PARTITION_TABLE_FILENAME="partitions_2MB.csv"
CONFIG_PARTITION_TABLE_OFFSET=0x8000
CONFIG_PARTITION_TABLE_MD5=y
CONFIG_ESP_CONSOLE_UART_CUSTOM=y
CONFIG_ESP_CONSOLE_SECONDARY_USB_SERIAL_JTAG=y
CONFIG_ESP_CONSOLE_USB_SERIAL_JTAG_ENABLED=y
CONFIG_ESP_CONSOLE_UART=y
CONFIG_ESP_CONSOLE_UART_CUSTOM_NUM_0=y
CONFIG_ESP_CONSOLE_UART_BAUDRATE=921600
```
